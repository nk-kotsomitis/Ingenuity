
/*
 * validation.c
 *
 * Copyright (C) 2025 Ingenuity
 *
 * This file is part of Ingenuity.
 *
 * Ingenuity is free software: you can redistribute it and/or modify
 * it under the terms of the GNU General Public License as published by
 * the Free Software Foundation, either version 3 of the License, or
 * (at your option) any later version.
 *
 * Ingenuity is distributed in the hope that it will be useful,
 * but WITHOUT ANY WARRANTY; without even the implied warranty of
 * MERCHANTABILITY or FITNESS FOR A PARTICULAR PURPOSE.  See the
 * GNU General Public License for more details.
 *
 * You should have received a copy of the GNU General Public License
 * along with Ingenuity.  If not, see <https://www.gnu.org/licenses/>.
 */
 
#include <stdint.h>
#include <string.h>
#include "validation.h"

const int8_t input_0[] = {85, -123, 24, 60, -29, 10, 95, -46, 63, -65, 93, 5, -39,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 45, 9};
const int8_t input_1[] = {35, 119, 49, 30, 52, -35, 45, -90, -76, 106, 94, 107, 102,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 -1, 45};
const int8_t input_2[] = {-103, -123, -86, 102, 38, -24, -98, -74, -30, 126, 72, 117, -89,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 26, -12};
const int8_t input_3[] = {61, 92, 42, 82, 91, -30, -71, 52, 117, -72, 97, -92, -39,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 14, 44};
const int8_t input_4[] = {58, -67, -61, -2, -9, 67, -128, 9, 65, -63, -13, 70, 12,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 47, 110};
const int8_t input_5[] = {120, -82, -112, -16, -98, -53, -42, -21, -60, 77, -14, -39, 44,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 -30, -14};
const int8_t input_6[] = {-104, 89, -74, 80, 17, 47, -20, 19, -38, -14, 88, -55, -112,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 49, 100};
const int8_t input_7[] = {11, -32, -42, 96, -1, 82, -69, -43, 8, 29, 53, 7, -121,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 8, -59};
const int8_t input_8[] = {-109, 47, -118, 4, 75, -49, 113, -99, -47, 81, 89, 18, 55,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 43, -28};
const int8_t input_9[] = {84, -10, -125, 127, 23, -55, 36, -5, 90, -57, -117, 76, -89,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 25, 55};


const int8_t *dataset_inputs[] = {input_0, input_1, input_2, input_3, input_4, input_5, input_6, input_7, input_8, input_9, };

        

const int8_t output_0[] = {-67, -19, -1, 23, 23, 32, 37, 48, 34, 37, 35, 39, 35,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 -5, -48};
const int8_t output_1[] = {-29, 8, 19, 45, 54, 64, 45, 47, 43, 48, 45, 44, 39,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 -43, -81};
const int8_t output_2[] = {-28, 5, 11, 34, 49, 63, 40, 41, 41, 46, 43, 44, 42,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 -39, -76};
const int8_t output_3[] = {-22, 12, 21, 43, 56, 68, 47, 47, 43, 47, 44, 47, 43,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 -31, -65};
const int8_t output_4[] = {-63, -16, 8, 31, 33, 37, 39, 48, 35, 40, 42, 44, 38,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 -21, -64};
const int8_t output_5[] = {-23, 8, 15, 34, 56, 74, 48, 45, 40, 45, 43, 46, 41,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 -29, -67};
const int8_t output_6[] = {-73, -19, 10, 31, 29, 31, 35, 46, 30, 36, 38, 38, 28,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 -28, -68};
const int8_t output_7[] = {-34, 11, 28, 57, 63, 66, 45, 46, 42, 48, 46, 44, 37,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 -36, -74};
const int8_t output_8[] = {-31, 7, 16, 37, 55, 70, 49, 44, 35, 40, 42, 45, 38,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 -27, -68};
const int8_t output_9[] = {-26, 9, 20, 42, 53, 66, 49, 47, 39, 44, 44, 44, 37,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 -29, -67};


const int8_t *dataset_outputs[] = {output_0, output_1, output_2, output_3, output_4, output_5, output_6, output_7, output_8, output_9, };

        

// **************** User Implementation ****************

#include <stdio.h>
#include "freertos/FreeRTOS.h"

uint32_t t0, t1 = 0;

static void val_print_str(const char *character)
{	
    printf("%s", character);
}

static void val_print_uint16(uint16_t value)
{
    printf("%"PRIu16"", value);
}

static void val_print_uint32(uint32_t value)
{
    printf("%"PRIu32"", value);
}

static uint32_t val_get_cycles()
{
    return esp_cpu_get_cycle_count();
}
// *******************************************************

#define HIST_ERROR_TOTAL 9
#define HIST_ERROR_N4P 0
#define HIST_ERROR_N3 1
#define HIST_ERROR_N2 2
#define HIST_ERROR_N1 3
#define HIST_ERROR_0 4
#define HIST_ERROR_P1 5
#define HIST_ERROR_P2 6
#define HIST_ERROR_P3 7
#define HIST_ERROR_P4P 8

uint16_t histogram[DATASET_LEN][HIST_ERROR_TOTAL] = {};

const char *comma = ", ";
const char *nl = "\n";
const char *hist_str = "histogram_";
const char *cycles_str = "cycles_";

void val_inference_start()
{
    t0 = val_get_cycles();	
}

void val_inference_end(uint32_t dataset_idx)
{
    t1 = val_get_cycles();

    val_print_str(cycles_str);
    val_print_uint32(dataset_idx);
    val_print_str(comma);
    val_print_uint32(t1 - t0);
    val_print_str(nl);
}

void histogram_add(int32_t error, uint32_t dataset_idx)
{
    // Update histogram
    switch (error) 
    {
        case -3:
            histogram[dataset_idx][HIST_ERROR_N3]++;
            break;
        case -2:
            histogram[dataset_idx][HIST_ERROR_N2]++;
            break;
        case -1:
            histogram[dataset_idx][HIST_ERROR_N1]++;
            break;
        case 0:
            histogram[dataset_idx][HIST_ERROR_0]++;
            break;
        case 1:
            histogram[dataset_idx][HIST_ERROR_P1]++;
            break;
        case 2:
            histogram[dataset_idx][HIST_ERROR_P2]++;
            break;
        case 3:
            histogram[dataset_idx][HIST_ERROR_P3]++;
            break;
        default:
            if(error >= 4)
            {
                histogram[dataset_idx][HIST_ERROR_P4P]++;
            }
            else if (error <= 4)
            {
                histogram[dataset_idx][HIST_ERROR_N4P]++;
            }
            else
            {
                // Unreachable code
            }
            break;						
    }
}

void histogram_show(uint32_t dataset_idx)
{   
    val_print_str(hist_str);
    val_print_uint32(dataset_idx);
    val_print_str(comma);
    val_print_uint16(histogram[dataset_idx][HIST_ERROR_N4P]);
    val_print_str(comma);
    val_print_uint16(histogram[dataset_idx][HIST_ERROR_N3]);
    val_print_str(comma);
    val_print_uint16(histogram[dataset_idx][HIST_ERROR_N2]);
    val_print_str(comma);
    val_print_uint16(histogram[dataset_idx][HIST_ERROR_N1]);
    val_print_str(comma);
    val_print_uint16(histogram[dataset_idx][HIST_ERROR_0]);
    val_print_str(comma);
    val_print_uint16(histogram[dataset_idx][HIST_ERROR_P1]);
    val_print_str(comma);
    val_print_uint16(histogram[dataset_idx][HIST_ERROR_P2]);
    val_print_str(comma);
    val_print_uint16(histogram[dataset_idx][HIST_ERROR_P3]);
    val_print_str(comma);
    val_print_uint16(histogram[dataset_idx][HIST_ERROR_P4P]);
    val_print_str(nl);
    
    memset(histogram, 0, sizeof(histogram));
}

void val_set_input(int8_t **input, uint32_t dataset_idx)
{
    for (uint16_t i = 0; i < DATASET_INPUT_LEN; i++) 
    {
        // Set the input
        (*input)[i] = dataset_inputs[dataset_idx][i];
    }
}

void val_output(int8_t *output, uint32_t dataset_idx)
{
    for (int i = 0; i < DATASET_INPUT_LEN; i++) 
    {    
        // Calculate the error    
        int32_t error = dataset_outputs[dataset_idx][i] - output[i];

        // Add to histogram
        histogram_add(error, dataset_idx);
    }

    // Print the histogram
    histogram_show(dataset_idx);
}

